## config/boards/shields/scorn/Kconfig.defconfig
```kconfig
if SHIELD_SCORN_LEFT

# Name must be less than 16 characters long!
config ZMK_KEYBOARD_NAME
    default "Scorn"

config ZMK_SPLIT_ROLE_CENTRAL
    default y

endif

if SHIELD_SCORN_LEFT || SHIELD_SCORN_RIGHT

config ZMK_SPLIT
    default y

endif
```

## config/boards/shields/scorn/Kconfig.shield
```kconfig
config SHIELD_SCORN_LEFT
    def_bool $(shields_list_contains,scorn_left)

# No whitespace after the comma or in your part name!
config SHIELD_SCORN_RIGHT
    def_bool $(shields_list_contains,scorn_right)
```
